## 12_kconfig_idf/src/Kconfig.projbuild
```kconfig
menu "WiFi"
    config SSID
        string "SSID"
        default "my ssid"
    config PASSWORD
        string "PASSWORD"
        default "my password"
endmenu
```
